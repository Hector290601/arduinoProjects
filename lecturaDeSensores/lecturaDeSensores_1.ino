#include <Wire.h>
#include <BH1750.h>
#include <Adafruit_GFX.h>
#include <Adafruit_SSD1306.h>
#include "I2Cdev.h"
#include "Adafruit_VL53L0X.h"
#include "MPU6050.h"
#define ANCHO 128
#define ALTO 64
#define OLED_RESET 4
#define A 2
#define B 3
#define button 4

// 'WhatsApp Image 2020-09-05 at 14', 48x48px
const unsigned char robletesLogo [] PROGMEM = {
  0x00, 0x00, 0x00, 0x00, 0x00, 0x00, 0x00, 0x00, 0x00, 0x00, 0x00, 0x00, 0x00, 0x00, 0x0f, 0xf0, 
  0x00, 0x00, 0x00, 0x00, 0xff, 0xf0, 0x00, 0x00, 0x00, 0x01, 0xff, 0xf8, 0x00, 0x00, 0x00, 0x01, 
  0xff, 0xf8, 0x10, 0x00, 0x00, 0x00, 0xff, 0xfc, 0x00, 0x00, 0x00, 0x01, 0xff, 0xfc, 0x10, 0x00, 
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  0xb7, 0x85, 0xc0, 0x00, 0x00, 0x00, 0x00, 0x00, 0x00, 0x00, 0x00, 0x00, 0x00, 0x00, 0x00, 0x00
};

// 'pythonLogo', 42x42px
const unsigned char pythonLogo [] PROGMEM = {
  0x00, 0x00, 0x00, 0x00, 0x00, 0x00, 0x00, 0x00, 0x00, 0x00, 0x00, 0x00, 0x00, 0x00, 0x7f, 0x80, 
  0x00, 0x00, 0x00, 0x03, 0xff, 0xf0, 0x00, 0x00, 0x00, 0x07, 0x00, 0x38, 0x00, 0x00, 0x00, 0x0e, 
  0x00, 0x1c, 0x00, 0x00, 0x00, 0x0c, 0xc0, 0x0c, 0x00, 0x00, 0x00, 0x0d, 0xe0, 0x0c, 0x00, 0x00, 
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  0x00, 0x00, 0x00, 0x00, 0x00, 0x00, 0x00, 0x00, 0x00, 0x00, 0x00, 0x00
};

// 'IC', 42x42px
const unsigned char icLogo [] PROGMEM = {
  0x00, 0x00, 0x00, 0x00, 0x00, 0x00, 0x00, 0x03, 0xf8, 0x00, 0x00, 0x00, 0x00, 0x07, 0xf8, 0x00, 
  0x00, 0x00, 0x00, 0x0f, 0xf8, 0x00, 0x00, 0x00, 0x00, 0x0f, 0xf8, 0x00, 0x00, 0x00, 0x00, 0x1f, 
  0xf8, 0x00, 0x00, 0x00, 0x00, 0x3f, 0xf8, 0x00, 0x00, 0x00, 0x00, 0x3f, 0xf8, 0x00, 0x00, 0x00, 
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  0x00, 0x00, 0x00, 0x3f, 0xf0, 0x00, 0x00, 0x00, 0x00, 0x0f, 0xc0, 0x00
};

// 'Raspberry-Pi-_Converted', 42x42px
const unsigned char rpiLogo [] PROGMEM = {
  0x00, 0x0f, 0x80, 0x00, 0x00, 0x00, 0x00, 0xf4, 0xe0, 0x0f, 0x00, 0x00, 0x00, 0x80, 0x18, 0xfa, 
  0xe0, 0x00, 0x00, 0xc0, 0x0d, 0xc0, 0x18, 0x00, 0x00, 0x84, 0x05, 0x00, 0x08, 0x00, 0x00, 0x81, 
  0x07, 0x00, 0x18, 0x00, 0x00, 0xc0, 0x86, 0x04, 0x18, 0x00, 0x00, 0x40, 0x66, 0x10, 0x18, 0x00, 
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  0x00, 0x00, 0xe7, 0x00, 0x00, 0x00, 0x00, 0x00, 0x3e, 0x00, 0x00, 0x00
};

// 'alerta', 42x42px
const unsigned char alert [] PROGMEM = {
  0x00, 0x00, 0x00, 0x00, 0x00, 0x00, 0x00, 0x00, 0x00, 0x00, 0x00, 0x00, 0x00, 0x00, 0x0c, 0x00, 
  0x00, 0x00, 0x00, 0x00, 0x1e, 0x00, 0x00, 0x00, 0x00, 0x00, 0x3f, 0x00, 0x00, 0x00, 0x00, 0x00, 
  0x3f, 0x00, 0x00, 0x00, 0x00, 0x00, 0x7f, 0x80, 0x00, 0x00, 0x00, 0x00, 0x7f, 0x80, 0x00, 0x00, 
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  0x00, 0x00, 0x00, 0x00, 0x00, 0x00, 0x00, 0x00, 0x00, 0x00, 0x00, 0x00
};

Adafruit_SSD1306 oled(ANCHO, ALTO, &Wire, OLED_RESET);
BH1750 luxometro;
Adafruit_VL53L0X lox = Adafruit_VL53L0X();
MPU6050 mpu(0x68);

int ax, ay, az, gx, gy, gz, currentPage = 0, currentType = 0, X, Y, numberOfPages = 5, numberOfTypes = 0, estadoA, estadoB, previoA, contador = 0;
bool bot, antBot, executing = false;

void selection(){
  /*
  X = analogRead(A0);
  if (X >= 0 && X < 400){
    if(currentPage < numberOfPages){
      currentPage ++;
    }else{
      currentPage = 0;
    }
    delay(300);
  }else if (X > 600 && X <= 1023){
    if(currentPage <= numberOfPages && currentPage > 0){
      currentPage --;
    }else{
      currentPage = numberOfPages;
    }
    delay(300);
  }*/
  estadoA = digitalRead(A);
  if(estadoA != previoA){
    estadoB = digitalRead(B);
    delay(10);
    if(estadoB != previoA ){
      if(currentPage < numberOfPages){
        currentPage ++;
      }else{
        currentPage = 0;
      }
    }else if(estadoB == previoA){
      if(currentPage <= numberOfPages && currentPage > 0){
        currentPage --;
      }else{
        currentPage = numberOfPages;
      }
    }
  }
  delay(150);
  previoA = estadoA;
}

void makeHead(){
  oled.clearDisplay();
  oled.setTextColor(WHITE);
  oled.setCursor(0, 0);
  oled.setTextSize(0.5);
  oled.print("CURRENT TIME: ");
  oled.print(millis() / 1000);
  oled.print("s");
  oled.setCursor(0, 9);
  oled.print("Page: ");
  oled.print(currentPage);
  oled.print(" Type: ");
  oled.print(currentType);
}


void setup(){
    Serial.begin(9600);
    pinMode(A, INPUT);
    pinMode(B, INPUT);
    pinMode(button, INPUT);
    previoA = digitalRead(A);
    Wire.begin();
    mpu.initialize();
    oled.begin(SSD1306_SWITCHCAPVCC, 0x3C);
    if(!luxometro.begin()){
      Serial.println(F("Error al iniciar LUXOMETRO"));
      while(1);
    }
    if (!lox.begin()){
      Serial.println(F("Error al iniciar VL53L0X"));
      while(1);
  }
}

void loop(){
  VL53L0X_RangingMeasurementData_t measure;
  uint16_t lux = luxometro.readLightLevel();
  mpu.getAcceleration(&ax, &ay, &az);
  mpu.getRotation(&gx, &gy, &gz);
  lox.rangingTest(&measure, false);
  selection();
  oled.setTextSize(1);
  oled.clearDisplay();
  makeHead();
  switch(currentPage){
    case 0:
      oled.drawBitmap(0, 16, icLogo, 42, 42, WHITE);
      oled.drawBitmap(43, 16, robletesLogo, 42, 42, WHITE);
      oled.drawBitmap(86, 16, pythonLogo, 42, 42, WHITE);
    break;
    case 1:
      oled.setCursor(42, 16);
      oled.drawBitmap(0, 16, rpiLogo, 42, 42, WHITE);
      oled.print("RPI Z W");
      oled.setCursor(42, 24);
      oled.print("STATUS: ");
      oled.print("OK");
      oled.setCursor(42, 32);
      oled.print("M / S: ");
      oled.print("SLAVE");
      oled.setCursor(42, 40);
      oled.print("ON/OFF: ");
      oled.print("ON");
      oled.setCursor(42, 48);
      oled.print("ACTUAL SCRIPT: ");
      oled.print("LANEDETECTION.PY");
    break;
    case 2:
      if (measure.RangeStatus != 4){
        oled.setCursor(0, 16);
        oled.print("VL53L0X: ");
        oled.print(measure.RangeMilliMeter);
        oled.print(" mm");
      }
      else{
      oled.drawRect(0, 16, 128, 16, WHITE);
      oled.setTextSize(1);
      oled.setCursor(0, 20);
      oled.print("OUT OF RANGE¡");
      }
    break;
    case 3:
      oled.setCursor(0, 16);
      oled.print("BH1750: ");
      oled.print(luxometro.readLightLevel());
      oled.print(" luxes");
    break;
    case 4:
      oled.setCursor(0, 16);
      oled.print("MPU6050: ");
      oled.setCursor(0, 24);
      oled.print("Ax:");
      oled.print(ax);
      oled.setCursor(0, 32);
      oled.print("Ay:");
      oled.print(ay);
      oled.setCursor(0, 40);
      oled.print("Az:");
      oled.print(az);
      oled.setCursor(0, 48);
      oled.print("Gx:");
      oled.print(gx);
      oled.setCursor(0, 56);
      oled.print("Gy:");
      oled.print(gy);
      oled.setCursor(0, 64);
      oled.print("Gz:");
      oled.print(gz);
    break;
    case 5:
      oled.drawBitmap(0, 16, alert, 42, 42, WHITE);
      bot = digitalRead(button);
      if(executing){
        if(!bot){
          Serial.print('\0x3');
          executing = false;
          antBot = !bot;
        }
        oled.setCursor(42, 16);
        oled.print("FINALIZAR");
        oled.setCursor(42, 24);
        oled.print("PROGRAMA");
      }else{
        if(!bot){
          Serial.print("python3 /home/hector_robles/test.py");
          antBot = bot;
          executing = true;
        }
        oled.setCursor(42, 16);
        oled.print("INICIAR");
        oled.setCursor(42, 24);
        oled.print("PROGRAMA");
      }
  }
  delay(100);
  oled.display();
}
